## dts/bindings/display/ultrachip,il0373.yaml
```yaml
# Copyright (c) 2026 David Girle
# SPDX-License-Identifier: Apache-2.0

description: UltraChip IL0373 EPD controller

compatible: "ultrachip,il0373"

include: ultrachip,uc81xx-common.yaml
```
